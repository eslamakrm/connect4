//#include "Nokia5110.h"
#include "Random.h"
#include "graph_lcd.h"

static const char board_pat[]={0xff,0x83,0x01,0x01,0x01,0x01,0x01,0x83};
static const char sel_pat[]	 ={0x00,0x00,0x00,0x01,0x03,0x01,0x00,0x00};
static  char X_pat[]				 ={0x00,0x00,0x38,0x7c,0x7c,0x7c,0x38,0x00};
static  char O_pat[]				 ={0x00,0x00,0x38,0x44,0x44,0x44,0x38,0x00};

char start[] = {
    0x00, 0x00, 0x00, 0x00, 0x00, 0x00, 0x00, 0x00, 0x00, 0x00, 0x00, 0x00, 0x00, 0x00,
  0x00, 0x00, 0x00, 0x00, 0x00, 0x00, 0x00, 0x00, 0x00, 0x00, 0x00, 0x00, 0x00, 0x00,
  0x00, 0x00, 0x00, 0x00, 0x00, 0x00, 0x00, 0x00, 0x00, 0x00, 0x00, 0x00, 0x00, 0x00,
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  0x00, 0x00, 0x00, 0x00, 0x00, 0x00, 0x00, 0x00, 0x00, 0x00, 0x00, 0x00, 0x00, 0x00
};



//Initialize the nokia driver
void renderer_init(){
	Random_Init(1);
	lcd_init();
}

//Render a position when a new move occures
void render(int pos_x, int pos_y, char player){
	cell(pos_x, pos_y, player);
}

//Draw the selected position for the current player
void draw_select(int pos, char player){
	int i;
	for(i=0;i<7;i++)
	{
	 if(i==pos)
	  {cell(i,0,'s');}
	 else
	  {cell(i,0,' ');}
	}
}


//Render the game over screen
void render_gameover(int winner){
	
	lcd_clear();  
	lcd_SetCursor(2,1);
	lcd_Str_TR("Game Over");
	lcd_SetCursor(2,4);
	if(winner == 1){
		lcd_Str_TR(" You lose");
	}else if(winner == 3){
		lcd_Str_TR("  Tie");
	}else{
		lcd_Str_TR(" You win");
	}
}


//Draw the selction arrow for the game mode selection screen
void select_vertical(int pos){
	int i;
	for(i = 0; i < 2; i++){
		lcd_SetCursor(i*7,5);
		if(i == pos)	
			lcd_Char_TR('>');
		else
			lcd_Char_TR(' ');
	}
}

//Draw the selction screen
void render_start(){ 
	lcd_clear();
	dis(start,sizeof(start));
	lcd_SetCursor(3,1);
	lcd_Str_TR("Connect4");
	lcd_SetCursor(0,5);
	lcd_Str_TR(">multi");
	lcd_SetCursor(8,5);
	lcd_Str_TR("single");
}
//Render the initial empty board on the screen
void render_board(){
int i,j,c;
	lcd_clear();
for (i=0;i<6;i++)
	{
		lcd_cmd_TR(0x40+i);
		lcd_cmd_TR(0x8d);
		
 		for (j=0;j<7;j++)
		{
			for (c=0;c<8;c++)
			{
				lcd_data_TR(board_pat[c]);
			}
		}
		if(i==0){lcd_data_TR(0xfe);}
		else lcd_data_TR(0xff);		
	}
}
